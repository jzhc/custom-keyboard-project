## zmk/Kconfig.defconfig
```kconfig
if SHIELD_JZHKEY_LEFT

config ZMK_KEYBOARD_NAME
    default "jzhkey"

config ZMK_SPLIT_ROLE_CENTRAL
    default y

endif

if SHIELD_JZHKEY_LEFT || SHIELD_JZHKEY_RIGHT

config ZMK_SPLIT
    default y

endif
```

## zmk/Kconfig.shield
```kconfig
config SHIELD_JZHKEY_LEFT
    def_bool $(shields_list_contains,jzhkey_left)


config SHIELD_JZHKEY_RIGHT
    def_bool $(shields_list_contains,jzhkey_right)
```
